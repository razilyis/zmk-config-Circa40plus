#include "circa40plus.dtsi"

&kscan0 {
    // Left-XiaoPlus1 pads 17, 23, 22, 21: Row0..3_L.
    row-gpios = <&gpio1 1 (GPIO_ACTIVE_HIGH | GPIO_PULL_DOWN)>,
                <&gpio1 7 (GPIO_ACTIVE_HIGH | GPIO_PULL_DOWN)>,
                <&gpio1 5 (GPIO_ACTIVE_HIGH | GPIO_PULL_DOWN)>,
                <&gpio1 3 (GPIO_ACTIVE_HIGH | GPIO_PULL_DOWN)>;
    // Pads 1, 2, 3, 4, 15, 16: Col0..5_L (Plus extra pads required).
    col-gpios = <&gpio0 2 GPIO_ACTIVE_HIGH>,
                <&gpio0 3 GPIO_ACTIVE_HIGH>,
                <&gpio0 28 GPIO_ACTIVE_HIGH>,
                <&gpio0 29 GPIO_ACTIVE_HIGH>,
                <&gpio0 15 GPIO_ACTIVE_HIGH>,
                <&gpio0 19 GPIO_ACTIVE_HIGH>;
};
