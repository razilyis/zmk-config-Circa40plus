## config/boards/shields/circa40plus/Kconfig.defconfig
```kconfig
if SHIELD_CIRCA40PLUS_LEFT || SHIELD_CIRCA40PLUS_RIGHT

config ZMK_KEYBOARD_NAME
    default "Circa40 Plus"

config ZMK_SPLIT
    default y

endif

if SHIELD_CIRCA40PLUS_RIGHT

config ZMK_SPLIT_ROLE_CENTRAL
    default y

config ZMK_POINTING
    default y

endif
```

## config/boards/shields/circa40plus/Kconfig.shield
```kconfig
config SHIELD_CIRCA40PLUS_LEFT
    def_bool $(shields_list_contains,circa40plus_left)

config SHIELD_CIRCA40PLUS_RIGHT
    def_bool $(shields_list_contains,circa40plus_right)
```

## config/west.yml
```yaml
manifest:
  remotes:
    - name: zmkfirmware
      url-base: https://github.com/zmkfirmware
    - name: sekigon-gonnoc
      url-base: https://github.com/sekigon-gonnoc
  projects:
    - name: zmk
      remote: zmkfirmware
      revision: 9ebbeff0a8b69a42f14aec022cdf16c7a107b9e0
      import: app/west.yml
    - name: zmk-driver-paw3222
      remote: sekigon-gonnoc
      revision: df652881be2520bde4f64ab6ca35e4c5708f4f9b
  self:
    path: config
```
